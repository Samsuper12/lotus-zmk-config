## boards/shields/keyboard_dongle/Kconfig.shield
```kconfig
config SHIELD_KEYBOARD_DONGLE
    def_bool $(shields_list_contains,keyboard_dongle)
```

## boards/shields/lotus581/Kconfig.defconfig
```kconfig
# Copyright (c) 2022 The ZMK Contributors
# SPDX-License-Identifier: MIT

if SHIELD_LOTUS581_DONGLE

config ZMK_KEYBOARD_NAME
    default "Lotus581"

config ZMK_SPLIT_ROLE_CENTRAL
    default y

config ZMK_USB
     default y

config ZMK_SPLIT
    default y

config ZMK_SPLIT_BLE_CENTRAL_PERIPHERALS
    default 2

config BT_MAX_CONN
    default 7

config BT_MAX_PAIRED
    default 7

endif

if SHIELD_LOTUS581_LEFT || SHIELD_LOTUS581_RIGHT

config ZMK_SPLIT
    default y

config ZMK_RGB_UNDERGLOW
    default y

config WS2812_STRIP
    default y

config ZMK_RGB_UNDERGLOW_EXT_POWER
    default y

if ZMK_DISPLAY

config I2C
    default y

config SSD1306
    default y

endif # ZMK_DISPLAY

if LVGL

config LV_Z_VDB_SIZE
    default 64

config LV_DPI_DEF
    default 148

config LV_Z_BITS_PER_PIXEL
    default 1

choice LV_COLOR_DEPTH
    default LV_COLOR_DEPTH_1
endchoice

endif # LVGL

endif
```

## boards/shields/lotus581/Kconfig.shield
```kconfig
# Copyright (c) 2022 The ZMK Contributors
# SPDX-License-Identifier: MIT

config SHIELD_LOTUS581_DONGLE
    def_bool $(shields_list_contains,lotus581_dongle)

config SHIELD_LOTUS581_LEFT
    def_bool $(shields_list_contains,lotus581_left)

config SHIELD_LOTUS581_RIGHT
    def_bool $(shields_list_contains,lotus581_right)
```

## boards/shields/lotus58_dongle/Kconfig.shield
```kconfig
config SHIELD_LOTUS58_DONGLE
    def_bool $(shields_list_contains,lotus58_dongle)
```

## config/west.yml
```yaml
manifest:
  remotes:
    - name: Samsuper12
      url-base: https://github.com/Samsuper12
    - name: carrefinho
      url-base: https://github.com/carrefinho
    - name: zmkfirmware
      url-base: https://github.com/zmkfirmware
    # Additional modules containing boards/shields/custom code can be listed here as well
    # See https://docs.zephyrproject.org/3.2.0/develop/west/manifest.html#projects
  projects:
    - name: zmk
      remote: zmkfirmware
      revision: main
      import: app/west.yml
    - name: prospector-zmk-module
      remote: carrefinho
      revision: main
    - name: os-layer-zmk-module
      remote: Samsuper12
      revision: usb_os_detector
  self:
    path: config
```
